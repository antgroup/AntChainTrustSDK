## 3rdparts/Kconfig
```kconfig
# SPDX-FileCopyrightText: 2026 Antchain (SHANGHAI) Digital Technology Co., Ltd.
# SPDX-License-Identifier: Apache-2.0

menu "Third-party Libraries"

choice ACTRUST_3RDPARTS_CRYPTO
    prompt "Crypto / TLS backend"
    default ACTRUST_3RDPARTS_CRYPTO_MBEDTLS
    help
        Crypto and TLS primitive provider. Used by the TLS and Crypto
        components.

config ACTRUST_3RDPARTS_CRYPTO_MBEDTLS
    bool "mbedTLS"

config ACTRUST_3RDPARTS_CRYPTO_NONE
    bool "None"

endchoice

choice ACTRUST_3RDPARTS_MQTT
    prompt "MQTT library"
    default ACTRUST_3RDPARTS_MQTT_COREMQTT
    help
        MQTT 3.1.1 client library. coreMQTT includes the Agent
        extension for thread-safe access.

config ACTRUST_3RDPARTS_MQTT_COREMQTT
    bool "coreMQTT + coreMQTT-Agent"

config ACTRUST_3RDPARTS_MQTT_NONE
    bool "None"

endchoice

choice ACTRUST_3RDPARTS_JSON
    prompt "JSON library"
    default ACTRUST_3RDPARTS_JSON_COREJSON

config ACTRUST_3RDPARTS_JSON_COREJSON
    bool "coreJSON"

config ACTRUST_3RDPARTS_JSON_NONE
    bool "None"

endchoice

choice ACTRUST_3RDPARTS_NTP
    prompt "NTP library"
    default ACTRUST_3RDPARTS_NTP_CORESNTP

config ACTRUST_3RDPARTS_NTP_CORESNTP
    bool "coreSNTP"

config ACTRUST_3RDPARTS_NTP_NONE
    bool "None"

endchoice

choice ACTRUST_3RDPARTS_BACKOFF
    prompt "Backoff algorithm"
    default ACTRUST_3RDPARTS_BACKOFF_BACKOFFALGO

config ACTRUST_3RDPARTS_BACKOFF_BACKOFFALGO
    bool "backoffAlgorithm"

config ACTRUST_3RDPARTS_BACKOFF_NONE
    bool "None"

endchoice

endmenu
```

## Kconfig
```kconfig
# SPDX-FileCopyrightText: 2026 Antchain (SHANGHAI) Digital Technology Co., Ltd.
# SPDX-License-Identifier: Apache-2.0

mainmenu "AntChainTrustSDK Configuration"

source "source/Kconfig"
source "3rdparts/Kconfig"
```

## source/Kconfig
```kconfig
# SPDX-FileCopyrightText: 2026 Antchain (SHANGHAI) Digital Technology Co., Ltd.
# SPDX-License-Identifier: Apache-2.0

source "source/core/Kconfig"
source "source/components/Kconfig"
source "source/adapter/Kconfig"
```

## source/adapter/Kconfig
```kconfig
# SPDX-FileCopyrightText: 2026 Antchain (SHANGHAI) Digital Technology Co., Ltd.
# SPDX-License-Identifier: Apache-2.0

menu "Adapter"

choice ACTRUST_ADAPTER_PLATFORM
    prompt "Target platform"
    default ACTRUST_ADAPTER_PLATFORM_LINUX
    help
        Select the target platform. This determines which adapter
        implementation is compiled (POSIX, SIMCom SDK, etc.).

config ACTRUST_ADAPTER_PLATFORM_LINUX
    bool "Linux"

config ACTRUST_ADAPTER_PLATFORM_ANDROID
    bool "Android"

config ACTRUST_ADAPTER_PLATFORM_SIMCOM_A7606E
    bool "SIMCom A7606E-H"

endchoice

menu "Security Slots"

config ACTRUST_SEC_SLOT_KEY_BASE
    hex "Key slot base ID"
    default 0x1000
    help
        Base hardware slot ID for cryptographic key storage (EC key pairs,
        AES keys). ACTRUST_SEC_SLOT_KEY(n) maps to this base plus n for
        platforms with contiguous key slots.

config ACTRUST_SEC_SLOT_KEY_COUNT
    int "Key slot count"
    default 8
    range 1 16

config ACTRUST_SEC_SLOT_DATA_BASE
    hex "Data slot base ID"
    default 0x2000
    help
        Base hardware slot ID for general-purpose secure data blobs.
        ACTRUST_SEC_SLOT_DATA(n) maps to this base plus n for platforms
        with contiguous data slots.

config ACTRUST_SEC_SLOT_DATA_COUNT
    int "Data slot count"
    default 8
    range 1 16

config ACTRUST_SEC_SLOT_CERT_BASE
    hex "Certificate slot base ID"
    default 0x3000
    help
        Base hardware slot ID for X.509 certificate storage.
        ACTRUST_SEC_SLOT_CERT(n) maps to this base plus n for platforms
        with contiguous certificate slots.

config ACTRUST_SEC_SLOT_CERT_COUNT
    int "Certificate slot count"
    default 8
    range 1 16

endmenu

menu "Security HW Capabilities"

config ACTRUST_SEC_HW_RANDOM
    bool "Hardware RNG"
    default n
    help
        Platform provides a hardware random number generator
        via actrust_sec_random().

config ACTRUST_SEC_HW_KEY_MGMT
    bool "Hardware key management"
    default n
    help
        Platform can generate, store, delete, and export keys
        inside a TEE / secure element.

config ACTRUST_SEC_HW_ECDSA
    bool "Hardware ECDSA sign/verify"
    default n
    depends on ACTRUST_SEC_HW_KEY_MGMT

config ACTRUST_SEC_HW_HASH
    bool "Hardware hash"
    default n

config ACTRUST_SEC_HW_AES
    bool "Hardware AES encrypt/decrypt"
    default n
    depends on ACTRUST_SEC_HW_KEY_MGMT

endmenu

if ACTRUST_ADAPTER_PLATFORM_LINUX

menu "Storage (Linux)"

config ACTRUST_STORAGE_BASE_DIR
    string "KV storage directory"
    default ".actrust/storage"
    help
        Base directory for file-backed KV storage. Each storage ID
        maps to a file: <prefix><id_hex>.bin.

config ACTRUST_SEC_STORE_BASE_DIR
    string "Secure storage directory"
    default ".actrust/security"
    help
        Base directory for file-backed security slots (keys, certs, data).
        This Linux adapter is a reference/development implementation, not a
        production secure-store or key-isolation boundary. Changing this path
        does not provide hardware-backed confidentiality, anti-tamper
        protection, rollback protection, or non-exportable private-key storage.
        Products that need to protect private keys must replace or extend the
        adapter with the target platform's actual TEE, secure element, TPM, or
        equivalent secure storage/key-management service.

config ACTRUST_STORAGE_FILE_PREFIX
    string "Storage file prefix"
    default "actrust_kv_"

config ACTRUST_STORAGE_REGION_SIZE
    int "Storage region size"
    default 75000
    help
        Logical byte capacity reserved for each file-backed storage region.
        The value must be large enough for the configured KV journal layout.

endmenu

endif

if ACTRUST_ADAPTER_PLATFORM_ANDROID

menu "Storage (Android)"

config ACTRUST_STORAGE_BASE_DIR
    string "KV storage directory"
    default "/data/local/tmp/actrust/storage"
    help
        Base directory for file-backed KV storage on Android. For production
        apps, override this to an app-private writable directory such as
        /data/data/<package>/files/actrust/storage.

config ACTRUST_SEC_STORE_BASE_DIR
    string "Secure storage directory"
    default "/data/local/tmp/actrust/security"
    help
        Base directory for file-backed security slots. This Android adapter is
        a reference/development implementation, not a production secure-store
        or key-isolation boundary. Changing this path, even to an app-private
        writable directory, does not provide Android Keystore/TEE-backed
        confidentiality, anti-tamper protection, rollback protection, or
        non-exportable private-key storage. Products that need to protect
        private keys must replace or extend the adapter with the target
        device's actual Android Keystore, TEE, secure element, or equivalent
        secure storage/key-management service.

config ACTRUST_STORAGE_FILE_PREFIX
    string "Storage file prefix"
    default "actrust_kv_"

config ACTRUST_STORAGE_REGION_SIZE
    int "Storage region size"
    default 75000
    help
        Logical byte capacity reserved for each file-backed storage region.
        The value must be large enough for the configured KV journal layout.

endmenu

endif

if ACTRUST_ADAPTER_PLATFORM_SIMCOM_A7606E

menu "Storage (SIMCom A7606E)"

config ACTRUST_STORAGE_BASE_DIR
    string "KV storage directory"
    default "/data/actrust/storage"
    help
        Base directory on the /data partition (persistent across reboots).

config ACTRUST_STORAGE_FILE_PREFIX
    string "Storage file prefix"
    default "actrust_kv_"

config ACTRUST_STORAGE_REGION_SIZE
    int "Storage region size"
    default 75000
    help
        Logical byte capacity reserved for each file-backed storage region.
        The value must be large enough for the configured KV journal layout.

endmenu

endif

endmenu
```

## source/components/Kconfig
```kconfig
# SPDX-FileCopyrightText: 2026 Antchain (SHANGHAI) Digital Technology Co., Ltd.
# SPDX-License-Identifier: Apache-2.0

menu "Components"

menuconfig ACTRUST_COMPONENTS_LOG
    bool "Log"
    default y
    help
        Formatted log output with compile-time level filtering.

if ACTRUST_COMPONENTS_LOG
source "source/components/log/Kconfig"
endif

menuconfig ACTRUST_COMPONENTS_QUEUE
    bool "Queue"
    default y
    help
        Thread-safe message queue built on adapter primitives.

if ACTRUST_COMPONENTS_QUEUE
source "source/components/queue/Kconfig"
endif

menuconfig ACTRUST_COMPONENTS_JSON
    bool "JSON"
    default y
    help
        JSON parser/serialiser with a component-local backend choice.

if ACTRUST_COMPONENTS_JSON
source "source/components/json/Kconfig"
endif

menuconfig ACTRUST_COMPONENTS_KV
    bool "Key-Value Store"
    default y
    help
        Persistent key-value storage with namespace isolation, backed
        by the adapter storage interface.

if ACTRUST_COMPONENTS_KV
source "source/components/kv/Kconfig"
endif

menuconfig ACTRUST_COMPONENTS_CRYPTO
    bool "Crypto"
    default y
    help
        Cryptographic operations (hashing, ECDSA, AES) with software
        fallback via mbedTLS and optional hardware acceleration.

if ACTRUST_COMPONENTS_CRYPTO
source "source/components/crypto/Kconfig"
endif

menuconfig ACTRUST_COMPONENTS_TLS
    bool "TLS"
    default y
    help
        TLS client built on mbedTLS. Used by MQTT and other components
        that require encrypted transport.

if ACTRUST_COMPONENTS_TLS
source "source/components/tls/Kconfig"
endif

menuconfig ACTRUST_COMPONENTS_NTP
    bool "NTP"
    default y
    help
        Periodic time synchronisation via SNTP (RFC 4330).

if ACTRUST_COMPONENTS_NTP
source "source/components/ntp/Kconfig"
endif

menuconfig ACTRUST_COMPONENTS_MQTT
    bool "MQTT"
    default y
    help
        MQTT 3.1.1 client with automatic reconnect, subscription
        persistence, and publish queue. Built on coreMQTT-Agent.

if ACTRUST_COMPONENTS_MQTT
source "source/components/mqtt/Kconfig"
endif

menuconfig ACTRUST_COMPONENTS_CLOUD
    bool "Cloud"
    default y
    help
        Cloud connectivity and device provisioning. Currently supports
        AWS IoT Core fleet provisioning.

if ACTRUST_COMPONENTS_CLOUD
source "source/components/cloud/Kconfig"
endif

endmenu
```

## source/components/cloud/Kconfig
```kconfig
# SPDX-FileCopyrightText: 2026 Antchain (SHANGHAI) Digital Technology Co., Ltd.
# SPDX-License-Identifier: Apache-2.0

choice ACTRUST_CLOUD_PLATFORM
    prompt "Cloud platform"
    default ACTRUST_CLOUD_PLATFORM_AWS
    help
        Select the cloud provider implementation to build.
    config ACTRUST_CLOUD_PLATFORM_AWS
        bool "AWS IoT Core"
    # Aliyun provider is not implemented yet.
    # config ACTRUST_CLOUD_PLATFORM_ALIYUN
    #     bool "Aliyun IoT Platform"
endchoice

config ACTRUST_CLOUD_DOWNLINK_QUEUE_SIZE
    int "Downlink message queue size"
    default 16
    range 1 256
    help
        Size of the downlink message queue.

menu "AWS IoT Core"
    depends on ACTRUST_CLOUD_PLATFORM_AWS

config ACTRUST_CLOUD_AWS_ENDPOINT
    string "AWS IoT endpoint"
    default ""
    help
        AWS IoT Core endpoint for MQTT/TLS connection, of the form
        xxxxxxxxxxxxxx-ats.iot.<region>.amazonaws.com.  Find it in the AWS
        IoT console under Settings -> Device data endpoint.  Required.

config ACTRUST_CLOUD_AWS_PORT
    int "AWS IoT MQTT port"
    default 8883
    range 1 65535
    help
        MQTT over TLS port of AWS IoT Core. Use 8883 for standard MQTT/TLS;
        some deployments may use 443 with the required TLS/ALPN setup.

config ACTRUST_CLOUD_AWS_TEMPLATE_NAME
    string "Fleet provisioning template name"
    default ""
    help
        Name of the AWS IoT fleet-provisioning template attached to your
        account.  Used by RegisterThing API.

config ACTRUST_CLOUD_AWS_PRODUCT_KEY
    string "Provisioning product key"
    default ""
    help
        Product key passed to provisioning template parameters.  Value is
        defined by the template you create in AWS IoT.

endmenu
```

## source/components/crypto/Kconfig
```kconfig
# SPDX-FileCopyrightText: 2026 Antchain (SHANGHAI) Digital Technology Co., Ltd.
# SPDX-License-Identifier: Apache-2.0

choice ACTRUST_CRYPTO_KEY_PROFILE
    prompt "Persistent private-key profile"
    default ACTRUST_CRYPTO_KEY_PROFILE_DEVELOPMENT
    help
        Select whether persistent private keys may use the software backend or
        must remain non-exportable in a platform TEE / secure element.

config ACTRUST_CRYPTO_KEY_PROFILE_DEVELOPMENT
    bool "Development software keys"
    help
        Permit software-generated private keys serialized through the adapter
        secure store. This profile is for development and reference platforms;
        it does not provide non-exportable private-key storage.

config ACTRUST_CRYPTO_KEY_PROFILE_PRODUCTION
    bool "Strict production hardware keys"
    depends on ACTRUST_SEC_HW_KEY_MGMT && ACTRUST_SEC_HW_ECDSA && ACTRUST_SEC_HW_AES
    help
        Require persistent private keys to use the hardware backend. Crypto
        initialization rejects adapters whose runtime capabilities do not match
        the configured hardware requirements. No hardware-to-software fallback
        is performed.

endchoice
```

## source/components/json/Kconfig
```kconfig
# SPDX-FileCopyrightText: 2026 Antchain (SHANGHAI) Digital Technology Co., Ltd.
# SPDX-License-Identifier: Apache-2.0

choice
    prompt "JSON backend"
    default ACTRUST_JSON_BACKEND_COREJSON

config ACTRUST_JSON_BACKEND_COREJSON
    bool "coreJSON"
    help
        Use AWS coreJSON as the backend implementation.

endchoice
```

## source/components/kv/Kconfig
```kconfig
# SPDX-FileCopyrightText: 2026 Antchain (SHANGHAI) Digital Technology Co., Ltd.
# SPDX-License-Identifier: Apache-2.0

menu "Limits"

config ACTRUST_KV_MAX_RECORDS
    int "Max records per partition"
    default 16

config ACTRUST_KV_NAMESPACE_MAX_LEN
    int "Max namespace length"
    default 32

config ACTRUST_KV_MAX_KEY_LEN
    int "Max key length"
    default 32

config ACTRUST_KV_MAX_VALUE_LEN
    int "Max value length"
    default 4096

endmenu

menu "Integrity"

config ACTRUST_KV_ENABLE_CRC
    bool "CRC on value writes"
    default y
    help
        Append a CRC32 checksum when writing values. Detects
        corruption from incomplete writes or bit-flips.

endmenu

menuconfig ACTRUST_KV_NS_MAP
    bool "Namespace-to-storage-ID map"
    default y
    help
        Static map from namespace string to adapter storage ID.
        When a namespace matches, the mapped storage ID is used
        instead of the default.

if ACTRUST_KV_NS_MAP

config ACTRUST_KV_NS_MAP_COUNT
    int "Active entries"
    range 0 4
    default 1

if ACTRUST_KV_NS_MAP_COUNT > 0

config ACTRUST_KV_NAMESPACE_0
    string "Entry 0: namespace"
    default "cloud_aws"

config ACTRUST_KV_NAMESPACE_STORAGE_ID_0
    hex "Entry 0: storage ID"
    default 0x12345679

endif

if ACTRUST_KV_NS_MAP_COUNT > 1

config ACTRUST_KV_NAMESPACE_1
    string "Entry 1: namespace"
    default ""

config ACTRUST_KV_NAMESPACE_STORAGE_ID_1
    hex "Entry 1: storage ID"
    default 0

endif

if ACTRUST_KV_NS_MAP_COUNT > 2

config ACTRUST_KV_NAMESPACE_2
    string "Entry 2: namespace"
    default ""

config ACTRUST_KV_NAMESPACE_STORAGE_ID_2
    hex "Entry 2: storage ID"
    default 0

endif

if ACTRUST_KV_NS_MAP_COUNT > 3

config ACTRUST_KV_NAMESPACE_3
    string "Entry 3: namespace"
    default ""

config ACTRUST_KV_NAMESPACE_STORAGE_ID_3
    hex "Entry 3: storage ID"
    default 0

endif

endif
```
