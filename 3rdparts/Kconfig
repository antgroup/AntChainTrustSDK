## source/components/log/Kconfig
```kconfig
# SPDX-FileCopyrightText: 2026 Antchain (SHANGHAI) Digital Technology Co., Ltd.
# SPDX-License-Identifier: Apache-2.0

choice ACTRUST_LOG_LEVEL
    prompt "Log level"
    default ACTRUST_LOG_LEVEL_INFO
    help
        Select the maximum compiled log verbosity. ERROR keeps only errors;
        WARN keeps errors and warnings; INFO keeps errors, warnings, and
        lifecycle information; DEBUG keeps all diagnostic logs.

config ACTRUST_LOG_LEVEL_ERROR
    bool "ERROR"

config ACTRUST_LOG_LEVEL_WARN
    bool "WARN"

config ACTRUST_LOG_LEVEL_INFO
    bool "INFO"

config ACTRUST_LOG_LEVEL_DEBUG
    bool "DEBUG"

endchoice

config ACTRUST_LOG_LINE_LEN
    int "Log line length"
    default 4096
    range 128 8192
    help
        Max length of the full log line (header + message).
```

## source/components/mqtt/Kconfig
```kconfig
# SPDX-FileCopyrightText: 2026 Antchain (SHANGHAI) Digital Technology Co., Ltd.
# SPDX-License-Identifier: Apache-2.0

menu "Message Limits"

config ACTRUST_MQTT_PAYLOAD_MAX_LEN
    int "Max payload length"
    default 4096
    range 1 16384

endmenu

menu "Connection"

config ACTRUST_MQTT_KEEPALIVE_SEC
    int "Keep-alive interval (seconds)"
    default 60
    range 10 3600

config ACTRUST_MQTT_CONNECT_TIMEOUT_MS
    int "Connect timeout (ms)"
    default 10000
    range 1000 30000

endmenu
```

## source/components/ntp/Kconfig
```kconfig
# SPDX-FileCopyrightText: 2026 Antchain (SHANGHAI) Digital Technology Co., Ltd.
# SPDX-License-Identifier: Apache-2.0

config ACTRUST_NTP_SERVER
    string "Default NTP server"
    default "pool.ntp.org"
    help
        Default NTP server hostname or IP address.

config ACTRUST_NTP_SYNC_PERIOD_SEC
    int "Sync period (seconds)"
    default 3600
    range 15 86400
    help
        Interval between periodic NTP synchronisation attempts.
        Per RFC 4330 Section 10, the poll interval SHOULD NOT be
        less than 15 seconds. The upper limit is 86400 (24 hours).

config ACTRUST_NTP_TIMEOUT_MS
    int "Single sync timeout (ms)"
    default 5000
    range 1000 30000
    help
        Timeout for a single NTP request-response exchange, including
        DNS resolution, UDP send, and response wait.

config ACTRUST_NTP_MAX_OFFSET_MS
    int "Maximum accepted NTP clock offset (ms)"
    default 86400000
    range 0 604800000
    help
        Maximum absolute clock offset accepted from one NTP response.
        The default is 24 hours. Set to 0 only for deployments that
        intentionally allow unauthenticated time bootstrap from any offset.
```

## source/components/tls/Kconfig
```kconfig
# SPDX-FileCopyrightText: 2026 Antchain (SHANGHAI) Digital Technology Co., Ltd.
# SPDX-License-Identifier: Apache-2.0

choice ACTRUST_TLS_MIN_VERSION
    prompt "Minimum supported TLS version"
    default ACTRUST_TLS_MIN_VERSION_1_2
    help
        Select the minimum TLS protocol version accepted by the TLS client.

config ACTRUST_TLS_MIN_VERSION_1_2
    bool "TLS 1.2"
    help
        Allow TLS 1.2 and above (up to the backend maximum).

config ACTRUST_TLS_MIN_VERSION_1_3
    bool "TLS 1.3"
    help
        Require TLS 1.3 or above.

endchoice
```

## source/core/Kconfig
```kconfig
# SPDX-FileCopyrightText: 2026 Antchain (SHANGHAI) Digital Technology Co., Ltd.
# SPDX-License-Identifier: Apache-2.0

menu "Core"

config ACTRUST_CORE_JOB_POOL_SIZE
    int "Job pool size"
    default 8
    range 2 32
    help
        Number of pre-allocated job objects. Each pending API call
        (connect, publish, register, ...) occupies one slot until the
        service task completes it.

config ACTRUST_CORE_JOB_QUEUE_CAPACITY
    int "Job queue capacity"
    default 8
    range 2 32
    help
        Maximum number of jobs that can be queued for the service task.
        If the queue is full, actrust_*() calls return ACTRUST_ERR_QUEUE_FULL.

config ACTRUST_CORE_SERVICE_STACK_SIZE
    int "Service task stack size (bytes)"
    default 4096
    range 1024 65536
    help
        Stack size of the internal service task that drains the job
        queue. Increase if deep call chains (TLS handshake, cloud
        provisioning) cause stack overflows.

config ACTRUST_CORE_SERVICE_PRIORITY
    int "Service task priority"
    default 5
    range 1 32
    help
        Scheduling priority of the service task (1 = lowest).

endmenu
```
